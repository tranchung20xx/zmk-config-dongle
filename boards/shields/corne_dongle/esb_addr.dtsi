/*
 * Copyright (c) 2020 Pete Johanson
 *
 * SPDX-License-Identifier: MIT
 */

 /{
    esb_split {
        compatible = "zmk,esb-split";
        // These are arbitrary default addresses. In end user products
        // different addresses should be used for each set of devices.
        base-addr-0 = <0xA3 0x7F 0x91 0x4D>;
        base-addr-1 = <0x58 0x2E 0xB4 0x19>;
        addr-prefix = <0xD1 0xC2 0xC3 0xC4 0xC5 0xC6 0xC7 0xC8>;
    };
};