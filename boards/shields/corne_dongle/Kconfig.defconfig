## boards/shields/corne_esb/Kconfig.defconfig
```kconfig
if SHIELD_CORNE_ESB_LEFT || SHIELD_CORNE_ESB_RIGHT

config ZMK_KEYBOARD_NAME
    default "Corne"

endif
```

## boards/shields/corne_esb/Kconfig.shield
```kconfig
config SHIELD_CORNE_ESB_LEFT
    def_bool $(shields_list_contains,corne_esb_left)

config SHIELD_CORNE_ESB_RIGHT
    def_bool $(shields_list_contains,corne_esb_right)
```
